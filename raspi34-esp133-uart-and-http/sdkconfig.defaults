## raspi34-esp133-uart-and-http/sdkconfig.defaults
```kconfig
# PSRAM Configuration (for large buffers)
CONFIG_SPIRAM=y
CONFIG_SPIRAM_MODE_OCT=y
CONFIG_SPIRAM_SPEED_80M=y

# Console output - use UART0 (via CH340 USB-UART bridge)
CONFIG_ESP_CONSOLE_UART_DEFAULT=y

# FreeRTOS
CONFIG_FREERTOS_HZ=1000

# Log level
CONFIG_LOG_DEFAULT_LEVEL_INFO=y
```
